## firmware/emg_esp32/sdkconfig.defaults
```kconfig
# Tick a 1000 Hz para que vTaskDelay(pdMS_TO_TICKS(2)) tenga resolución real de 2 ms.
# Con el valor por defecto (100 Hz / 10 ms por tick) el delay de 2 ms se
# redondearía a 0 ticks y rompería el muestreo de ~500 Hz.
CONFIG_FREERTOS_HZ=1000
```
